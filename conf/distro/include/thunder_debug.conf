## conf/distro/include/thunder_debug.conf
```bitbake
# FIXME: debug type has to be passed/selected based on the thunder build type requirement"
THUNDER_BUILDTYPE = "thunder_debugoptimized"
```

## conf/distro/include/thunder_generic.conf
```bitbake
# Enable thunder flag to enable thunder specific events
DISTRO_FEATURES:append = " thunder"
THUNDER_BUILDTYPE = "thunder_release"
DISTRO_FEATURES:append = " ${THUNDER_BUILDTYPE}"

DISTROOVERRIDES .= ":${DISTRO_CODENAME}"
DISTROOVERRIDES .= ":${DISTRO}"
DISTROOVERRIDES .= "${@bb.utils.contains("DISTRO_FEATURES", "wpeframework", ":wpeframework", "", d)}"

# Set thunder permissions based on moudule requirements
require thunder_permissions.inc
```

## conf/distro/include/thunder_permissions.inc
```bitbake
ROOTFS_POSTPROCESS_COMMAND:append = " update_thunder_path_permissions;"
update_thunder_path_permissions () {
    if [ "${THUNDER_GROUP}" != "" ] && [ "${THUNDER_SUPER_USER_GROUP}" != "" ]; then
        if [ -d "${IMAGE_ROOTFS}/${THUNDER_INSTALL_PATH}" ]; then
            chmod 0550 "${IMAGE_ROOTFS}/${THUNDER_INSTALL_PATH}"
            chown "${THUNDER_SUPER_USER_GROUP}:${THUNDER_GROUP}" "${IMAGE_ROOTFS}/${THUNDER_INSTALL_PATH}"
        fi
	if [ -d "${IMAGE_ROOTFS}/${THUNDER_PERSISTENT_PATH}" ]; then
            chmod 0755 "${IMAGE_ROOTFS}/${THUNDER_PERSISTENT_PATH}"
            chown "${THUNDER_SUPER_USER_GROUP}:${THUNDER_SUPER_USER_GROUP}" "${IMAGE_ROOTFS}/${THUNDER_PERSISTENT_PATH}"
        fi
	if [ -d "${IMAGE_ROOTFS}/${THUNDER_PERSISTENT_PATH}/WPEFramework" ]; then
            chmod 0770 "${IMAGE_ROOTFS}/${THUNDER_PERSISTENT_PATH}/WPEFramework"
            chown "${THUNDER_SUPER_USER_GROUP}:${THUNDER_GROUP}" "${IMAGE_ROOTFS}/${THUNDER_PERSISTENT_PATH}/WPEFramework"
        fi

    fi
}
```

## conf/layer.conf
```bitbake
# We have a conf and classes directory, add to BBPATH
BBPATH .= ":${LAYERDIR}"

# We have recipes-* directories, add to BBFILES
BBFILES += "${LAYERDIR}/recipes-*/*/*.bb \
            ${LAYERDIR}/recipes-*/*/*.bbappend"

BBFILE_COLLECTIONS += "meta-thunder-framework"
BBFILE_PATTERN_meta-thunder-framework = "^${LAYERDIR}/"
BBFILE_PRIORITY_meta-thunder-framework = "20"

LAYERDEPENDS_meta-thunder-framework = "\
    core \
    openembedded-layer \
    meta-python \
"

BBFILES_DYNAMIC += "\
    virtualization:${LAYERDIR}/dynamic-layers/virtualization/recipes-*/*/*.bb \
    virtualization:${LAYERDIR}/dynamic-layers/virtualization/recipes-*/*/*.bbappend \
"

LICENSE_PATH += "${LAYERDIR}/licenses"

require distro/include/thunder_generic.conf

# Note: To build wpa_supplicant in the debug mode -R thunder_debug.conf should be used

# RDK expects this to be on by default 
DISTRO_FEATURES:append:rdk = " cryptography security"

# This layer only support R4 for now
DISTRO_FEATURES:append:rdk = " wpe_r4"

# Wayland is the way
DISTRO_FEATURES:remove = "x11"

LAYERSERIES_COMPAT_meta-thunder-framework = "dunfell kirkstone scarthgap"
```
